## config/boards/shields/icarus56/Kconfig.defconfig
```kconfig
if SHIELD_ICARUS56_LEFT

config ZMK_KEYBOARD_NAME
    default "Icarus56"

config ZMK_SPLIT_ROLE_CENTRAL
    default y

endif

if SHIELD_ICARUS56_RIGHT

config ZMK_KEYBOARD_NAME
    default "Icarus56"

endif
```

## config/boards/shields/icarus56/Kconfig.shield
```kconfig
config SHIELD_ICARUS56_LEFT
    def_bool $(shields_list_contains,icarus56_left)

config SHIELD_ICARUS56_RIGHT
    def_bool $(shields_list_contains,icarus56_right)
```
